## main/Kconfig.projbuild
```kconfig
menu "Windsensor Configuration"

    config ESP_WIFI_SSID
        string "SoftAP SSID"
        default "yanus-wind"
        help
            SSID (network name) to set up the softAP with.

    config ESP_WIFI_PASSWORD
        string "SoftAP Password"
        default "EglaisEglais"
        help
            WiFi password (WPA or WPA2) for the example to use for the softAP.

    config ESP_MAX_STA_CONN
        int "Maximal STA connections"
        default 10
        help
            Max number of the STA connects to AP.

    config I2C_MASTER_SCL
        int "SCL GPIO Num"
        default 6 if IDF_TARGET_ESP32C3 || IDF_TARGET_ESP32C2 || IDF_TARGET_ESP32H2
        default 19 if IDF_TARGET_ESP32 || IDF_TARGET_ESP32S2 || IDF_TARGET_ESP32S3
        help
            GPIO number for I2C Master clock line.

    config I2C_MASTER_SDA
        int "SDA GPIO Num"
        default 5 if IDF_TARGET_ESP32C3 || IDF_TARGET_ESP32C2 || IDF_TARGET_ESP32H2
        default 18 if IDF_TARGET_ESP32 || IDF_TARGET_ESP32S2 || IDF_TARGET_ESP32S3
        help
            GPIO number for I2C Master data line.

    config I2C_MASTER_FREQ_HZ
        int "I2C master frequency"
        default 400000

    config NMEA_UDP_PORT
        int "NMEA UDP broadcast port"
        default 9000

    config SPEED_SENSOR_GPIO
        int "Speed signal input pin"
        default 4

    config SIMULATION_GPIO
        int "Simulated speed signal pin"
        default 5

    config SPEED_SENSOR_DEBOUNCE_MS
        int "Speed sensor debouncing time, ms"
        default 30

endmenu
```

## sdkconfig.defaults
```kconfig
CONFIG_LWIP_MAX_SOCKETS=16
CONFIG_HTTPD_MAX_REQ_HDR_LEN=1500
CONFIG_PARTITION_TABLE_CUSTOM_FILENAME="partitions.csv"
CONFIG_PARTITION_TABLE_CUSTOM=y
CONFIG_ESPTOOLPY_FLASHSIZE_4MB=y
```
